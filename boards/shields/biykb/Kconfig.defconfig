## boards/shields/biykb/Kconfig.defconfig
```kconfig
if SHIELD_BIYKB

config ZMK_USB
    default y

config ZMK_BLE
    default y

# Name must be less than 16 characters long!
config ZMK_KEYBOARD_NAME
    default "Keyboard is you"

endif
```

## boards/shields/biykb/Kconfig.shield
```kconfig
# No whitespace after the comma or in your keyboard name!
config SHIELD_BIYKB
    def_bool $(shields_list_contains,biykb)
```
